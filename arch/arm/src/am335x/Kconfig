## arch/arm/src/am335x/Kconfig
```kconfig
#
# For a description of the syntax of this configuration file,
# see the file kconfig-language.txt in the NuttX tools repository.
#

if ARCH_CHIP_AM335X

comment "AM335x Configuration Options"

choice
	prompt "TI AM335X Chip Selection"
	default ARCH_CHIP_AM3358

config ARCH_CHIP_AM3358
	bool "AM3358"

endchoice

menu "TI AM335X Peripheral Support"

config AM335X_UART0
	bool "UART 0"
	default n
	select UART0_SERIALDRIVER
	select ARCH_HAVE_SERIAL_TERMIOS

config AM335X_UART1
	bool "UART 1"
	default n
	select UART1_SERIALDRIVER
	select ARCH_HAVE_SERIAL_TERMIOS

config AM335X_UART2
	bool "UART 2"
	default n
	select UART2_SERIALDRIVER
	select ARCH_HAVE_SERIAL_TERMIOS

config AM335X_UART3
	bool "UART 3"
	default n
	select UART3_SERIALDRIVER
	select ARCH_HAVE_SERIAL_TERMIOS

config AM335X_UART4
	bool "UART 4"
	default n
	select UART4_SERIALDRIVER
	select ARCH_HAVE_SERIAL_TERMIOS

config AM335X_UART5
	bool "UART 5"
	default n
	select UART5_SERIALDRIVER
	select ARCH_HAVE_SERIAL_TERMIOS

config AM335X_DMTIMER0
	bool "Timer 0"
	default n

config AM335X_DMTIMER2
	bool "Timer 2"
	default n

config AM335X_DMTIMER3
	bool "Timer 3"
	default n

config AM335X_DMTIMER4
	bool "Timer 4"
	default n

config AM335X_DMTIMER5
	bool "Timer 5"
	default n

config AM335X_DMTIMER6
	bool "Timer 6"
	default n

config AM335X_DMTIMER7
	bool "Timer 7"
	default n

config AM335X_IRQ_WD
	bool "Watchdog"
	default n

config AM335X_EDMA
	bool "Enhanced Direct Memory Access"
	default n

config AM335X_GPIO
	bool "GPIO"
	default n

config AM335X_LCD
	bool "LCD controller"
	default n
	depends on EXPERIMENTAL

config AM335X_TSC
	bool "Touchscreen Controller"
	default n

config AM335X_LCDC
	bool "LCD Controller"
	default n

config AM335X_CPSW
	bool "Ethernet subsustem"
	default n

config AM335X_PWMSS
	bool "Pulse-Width Modulation Subsystem"
	default n

config AM335X_USB0
	bool "USB 0"
	default n

config AM335X_USB1
	bool "USB 1"
	default n

config AM335X_MMCHS0
	bool "MMC/SD/SDIO0 High Speed Host Controller 0"
	default n

config AM335X_MMCHS1
	bool "MMC/SD/SDIO0 High Speed Host Controller 1"
	default n

config AM335X_MMCHS2
	bool "MMC/SD/SDIO0 High Speed Host Controller 2"
	default n

config AM335X_I2C0
	bool "Multi-master I2C Controller 0"
	default n

config AM335X_I2C0
	bool "Multi-master I2C Controller 1"
	default n

config AM335X_I2C0
	bool "Multi-master I2C Controller 2"
	default n

config AM335X_MCASP0
	bool "Multichannel Audio Serial Port 0"
	default n

config AM335X_MCASP1
	bool "Multichannel Audio Serial Port 1"
	default n

config AM335X_DCAN0
	bool "DCAN Bus 0 Controller"
	default n

config AM335X_DCAN1
	bool "DCAN Bus 1 Controller"
	default n

config AM335X_MCSPI0
	bool "MCSPI 0"
	default n

config AM335X_MCSPI1
	bool "MCSPI 1"
	default n

config AM335X_IRQ_PERFMU
	bool "Performance monitor"
	default n

config AM335X_SGX
	bool "Graphics Accelerator"
	default n

endmenu

config AM335X_GPIO_IRQ
	bool "GPIO interrupts"
	default n
	---help---
		Select to enable support for GPIO interrupts.  These will
		be handled through a second level of interrupt decoding and will
		otherwise appear as any other interrupt.

choice
	prompt "Boot device"
	default AM335X_BOOT_SDCARD

config AM335X_BOOT_NAND
	bool "NAND FLASH"

config AM335X_BOOT_SPINOR
	bool "SPI NOR FLASH"

config AM335X_BOOT_SDCARD
	bool "SD card"

config AM335X_BOOT_USB
	bool "USB"

endchoice # Boot device

config AM335X_DDR_MAPOFFSET
	int "Installed SDRAM offset"
	default 0
	---help---
		The size of the installed SRAM memory is required in order to
		properly configure memory mapping.  The mapping will begin at the
		start of SDRAM plus AM335X_DDR_MAPOFFSET and extend for DDR_MAPSIZE
		bytes.  NOTE typically AM335X_MAP_OFFSET is zero and AM335X_DDR_MAPSIZE is
		the full, installed size of the DRAM.  But these values can be
		modified to set aside memory at the beginning or end of SRAM that is
		unmapped (or mapped differently).  NOTE also that this value relates
		closely to other settings:

			RAM_START and RAM_VSTART give this physical and virtual addresses
			of the start of usable memory (begining with .text).  NOTE that
			this may not necessarily be the actual start of the mapped SDRAM
			region.  It will be larger if NuttX begins at an offset from
			beginning of mapped SDRAM (which is the normal case).

			RAM_SIZE gives the size of the .text, .data, and .bss sections
			plus the size of the available heap.  NOTE that RAM_SIZE may not
			include all of SDRAM up to the end of mapped region.

config AM335X_DDR_MAPSIZE
	int "Installed SDRAM size"
	default 536870912
	---help---
		The size of the installed SRAM memory is required in order to
		properly configure memory mapping.  The mapping will begin at the
		start of SDRAM plus AM335X_DDR_MAPOFFSET and extend for DDR_MAPSIZE
		bytes.  NOTE typically AM335X_MAP_OFFSET is zero and AM335X_DDR_MAPSIZE is
		the full, installed size of the DRAM.  But these values can be
		modified to set aside memory at the beginning or end of SRAM that is
		unmapped (or mapped differently).  NOTE also that this value relates
		closely to other settings:

			RAM_START and RAM_VSTART give this physical and virtual addresses
			of the start of usable memory (begining with .text).  NOTE that
			this may not necessarily be the actual start of the mapped SDRAM
			region.  It will be larger if NuttX begins at an offset from
			beginning of mapped SDRAM (which is the normal case).

			RAM_SIZE gives the size of the .text, .data, and .bss sections
			plus the size of the available heap.  NOTE that RAM_SIZE may not
			include all of SDRAM up to the end of mapped region.

menu "LCD Configuration"
	depends on AM335X_LCD

config AM335X_LCD_VRAMBASE
	hex "Video RAM base address"
	default 0xa0010000
	---help---
		Base address of the video RAM frame buffer.  The default is
		(AM335X_EXTDRAM_CS0 + 0x00010000)

config AM335X_LCD_USE_CLKIN
	bool "Use optional input clock"
	default n

config AM335X_LCD_CLKIN_FREQUENCY
	int "Input clock frequency"
	default 0
	depends on AM335X_LCD_USE_CLKIN

config AM335X_LCD_REFRESH_FREQ
	int "LCD refesh rate (Hz)"
	default 50
	---help---
		LCD refesh rate (Hz)

config AM335X_LCD_BACKLIGHT
	bool "Enable backlight"
	default y
	---help---
		Enable backlight support.  If AM335X_LCD_BACKLIGHT is selected, then
		the board-specific logic must provide this lpc54_backlight()
		interface so that the LCD driver can turn the backlight on and off
		as necessary.  You should select this option and implement
		lpc54_backlight() if your board provides GPIO control over the
		backlight.  This interface provides only ON/OFF control of the
		backlight.  If you want finer control over the backlight level (for
		example, using PWM), then this interface would need to be extended.

config AM335X_LCD_TFTPANEL
	bool "TFT Panel"
	default y
	---help---
		TFT Panel vs. STN display.  STN display panels require algorithmic
		pixel pattern generation to provide pseudo gray scaling on
		monochrome displays, or color creation on color displays.  TFT
		display panels require the digital color value of each pixel to be
		applied to the display data inputs.

config AM335X_LCD_MONOCHROME
	bool "Monochrome LCD"
	default n
	depends on !AM335X_LCD_TFTPANEL
	---help---
		STN LCD monochrome/color selection.  Selects monochrome LCD.  This
		selection has no meaning for a TFT panel.

choice
	prompt "Bits per pixel"
	default AM335X_LCD_BPP24 if AM335X_LCD_TFTPANEL
	default AM335X_LCD_BPP16_565 if !AM335X_LCD_TFTPANEL

config AM335X_LCD_BPP1
	bool "1 BPP"
	depends on AM335X_LCD_MONOCHROME

config AM335X_LCD_BPP2
	bool "2 BPP"
	depends on AM335X_LCD_MONOCHROME

config AM335X_LCD_BPP4
	bool "4 BPP"
	depends on AM335X_LCD_MONOCHROME

config AM335X_LCD_BPP8
	bool "8 BPP"
	depends on AM335X_LCD_MONOCHROME

config AM335X_LCD_BPP12_444
	bool "12 bpp, 4:4:4 mode"
	depends on !AM335X_LCD_MONOCHROME

config AM335X_LCD_BPP16
	bool "16 BPP"
	depends on AM335X_LCD_MONOCHROME

config AM335X_LCD_BPP16_565
	bool "16 BPP, 5:6:5 mode"
	depends on !AM335X_LCD_MONOCHROME

config AM335X_LCD_BPP24
	bool "24 BPP, 8:8:8 mode"
	depends on AM335X_LCD_TFTPANEL

endchoice

config AM335X_LCD_BGR
	bool "Blue-Green-Red color order"
	default n
	depends on !AM335X_LCD_MONOCHROME
	---help---
		This option selects BGR color order vs. default RGB

config AM335X_LCD_BACKCOLOR
	hex "Initial background color"
	default 0x0
	---help---
		Initial background color

config AM335X_LCD_HWIDTH
	int "Display width (pixels)"
	default 480
	---help---
		Horizontal width the display in pixels

config AM335X_LCD_HPULSE
	int "Horizontal pulse"
	default 2

config AM335X_LCD_HFRONTPORCH
	int "Horizontal front porch"
	default 5

config AM335X_LCD_HBACKPORCH
	int "Horizontal back porch"
	default 40

config AM335X_LCD_VHEIGHT
	int "Display height (rows)"
	default 272
	---help---
		Vertical height of the display in rows

config AM335X_LCD_VPULSE
	int "Vertical pulse"
	default 2

config AM335X_LCD_VFRONTPORCH
	int "Vertical front porch"
	default 8

config AM335X_LCD_VBACKPORCH
	int "Vertical back porch"
	default 8

endmenu # LCD Configuration
endif # ARCH_CHIP_AM335X
```

## arch/arm/src/imxrt/Kconfig
```kconfig
#
# For a description of the syntax of this configuration file,
# see the file kconfig-language.txt in the NuttX tools repository.
#

comment "i.MX RT Configuration Options"

choice
	prompt "i.MX RT Chip Selection"
	default ARCH_CHIP_MIMXRT1052DVL6A
	depends on ARCH_CHIP_IMXRT

config ARCH_CHIP_MIMXRT1051DVL6A
	bool "MIMXRT1051DVL6A"
	select ARCH_FAMILY_MXRT105xDVL6A

config ARCH_CHIP_MIMXRT1051CVL5A
	bool "MIMXRT1051CVL5A"
	select ARCH_FAMILY_IMIMXRT105xCVL5A

config ARCH_CHIP_MIMXRT1052DVL6A
	bool "MIMXRT1052DVL6A"
	select ARCH_FAMILY_MXRT105xDVL6A

config ARCH_CHIP_MIMXRT1052CVL5A
	bool "MIMXRT1052DVL6A"
	select ARCH_FAMILY_MIMXRT1052CVL5A

endchoice # i.MX RT Chip Selection

# i.MX RT Families

config ARCH_FAMILY_MXRT105xDVL6A
	bool
	default n
	select ARCH_FAMILY_IMXRT105x
	---help---
		i.MX RT1050 Crossover Processors for Consumer Products

config ARCH_FAMILY_MIMXRT1052CVL5A
	bool
	default n
	select ARCH_FAMILY_IMXRT105x
	---help---
		i.MX RT1050 Crossover Processors for Industrial Products

config ARCH_FAMILY_IMXRT105x
	bool
	default n

# Peripheral support

config IMXRT_HAVE_LPUART
	bool
	default n

menu "i.MX RT Peripheral Selection"

menu "FlexIO Peripherals"

endmenu # FlexIO Peripherals

menu "LPUART Peripherals"

config IMXRT_LPUART1
	bool "LPUART1"
	default n
	select LPUART1_SERIALDRIVER
	select IMXRT_HAVE_LPUART

config IMXRT_LPUART2
	bool "LPUART2"
	default n
	select LPUART2_SERIALDRIVER
	select IMXRT_HAVE_LPUART

config IMXRT_LPUART3
	bool "LPUART3"
	default n
	select LPUART3_SERIALDRIVER
	select IMXRT_HAVE_LPUART

config IMXRT_LPUART4
	bool "LPUART4"
	default n
	select LPUART4_SERIALDRIVER
	select IMXRT_HAVE_LPUART

config IMXRT_LPUART5
	bool "LPUART5"
	default n
	select LPUART5_SERIALDRIVER
	select IMXRT_HAVE_LPUART

config IMXRT_LPUART6
	bool "LPUART6"
	default n
	select LPUART6_SERIALDRIVER
	select IMXRT_HAVE_LPUART

config IMXRT_LPUART7
	bool "LPUART7"
	default n
	select LPUART7_SERIALDRIVER
	select IMXRT_HAVE_LPUART

config IMXRT_LPUART8
	bool "LPUART8"
	default n
	select LPUART8_SERIALDRIVER
	select IMXRT_HAVE_LPUART

endmenu # LPUART Peripherals
endmenu # i.MX RT Peripheral Selection

menuconfig IMXRT_GPIO_IRQ
	bool "GPIO Interrupt Support"
	default n

if IMXRT_GPIO_IRQ

config IMXRT_GPIO1_0_15_IRQ
	bool "GPIO1 Pins 8-15 interrupts"
	default n

config IMXRT_GPIO1_16_31_IRQ
	bool "GPIO1 Pins 16-31 interrupts"
	default n

config IMXRT_GPIO2_0_15_IRQ
	bool "GPIO2 Pins 0-15 interrupts"
	default n

config IMXRT_GPIO2_16_31_IRQ
	bool "GPIO2 Pins 16-31 interrupts"
	default n

config IMXRT_GPIO3_0_15_IRQ
	bool "GPIO3 Pins 0-15 interrupts"
	default n

config IMXRT_GPIO3_16_31_IRQ
	bool "GPIO3 Pins 16-31 interrupts"
	default n

config IMXRT_GPIO4_0_15_IRQ
	bool "GPIO4 Pins 0-15 interrupts"
	default n

config IMXRT_GPIO4_16_31_IRQ
	bool "GPIO4 Pins 16-31 interrupts"
	default n

endif # IMXRT_GPIO_IRQ
```

## arch/arm/src/stm32h7/Kconfig
```kconfig
#
# For a description of the syntax of this configuration file,
# see the file kconfig-language.txt in the NuttX tools repository.
#

if ARCH_CHIP_STM32H7

comment "STM32 H7 Configuration Options"

choice
	prompt "STM32 H7 Chip Selection"
	default ARCH_CHIP_STM32H743ZI
	depends on ARCH_CHIP_STM32H7

config ARCH_CHIP_STM32H743ZI
	bool "STM32H743ZI"
	select STM32H7_STM32H7X3XX
	select STM32H7_FLASH_CONFIG_I
# TODO: IO_CONFIG
	---help---
		STM32 H7 Cortex M7, 2048 FLASH, 1024K Kb SRAM

endchoice # STM32 H7 Chip Selection

config STM32H7_STM32H7X3XX
	bool
	default n
	select ARCH_HAVE_FPU
# TODO:	select ARCH_HAVE_DPFPU
	select ARMV7M_HAVE_ICACHE
	select ARMV7M_HAVE_DCACHE
	select ARMV7M_HAVE_ITCM
	select ARMV7M_HAVE_DTCM

config STM32H7_FLASH_CONFIG_I
	bool
	default n

choice
	prompt "Override Flash Size Designator"
	depends on ARCH_CHIP_STM32H7
	default STM32H7_FLASH_OVERRIDE_DEFAULT
	---help---
		STM32H7 series parts numbering (sans the package type) ends with a letter
		that designates the FLASH size.

				Designator  Size in KiB
				   I	2048

		This configuration option defaults to using the configuration based on that designator
		or the default smaller size if there is no last character designator is present in the
		STM32 Chip Selection.

		Examples:
		   If the STM32H743ZI is chosen, the Flash configuration would be 'I', if a variant of
		   the part is released in the future one could simply select another designator here.

		   If an STM32H7xxx Series parts is chosen the default Flash configuration will be set
		   herein and can be changed.

config STM32H7_FLASH_OVERRIDE_DEFAULT
			bool "Default"

config STM32H7_FLASH_OVERRIDE_I
			bool "I 2048KiB"

endchoice # "Override Flash Size Designator"

endif # ARCH_CHIP_STM32H7
```

## arch/or1k/src/mor1kx/Kconfig
```kconfig
#
# For a description of the syntax of this configuration file,
# see the file kconfig-language.txt in the NuttX tools repository.
#

comment "OpenRISC Configuration Options"

choice
  prompt "Toolchain Selection"
  default OR1K_TOOLCHAIN_GNU_ELF

config OR1K_TOOLCHAIN_GNU_ELF
  bool "OpenRISC GNU ELF toolchain under Linux (or other POSIX environment)"
  ---help---
    OpenRISC GNU toolchain.

endchoice

menu "OpenRISC Peripheral Support"

config OR1K_MMU
	bool "MMU"
	default n

config SAMDL_FPU
	bool "Floating Point Unit"
	default y

config SAMDL_SIMD
	bool "SIMD"
	default n

endmenu
```

## arch/renesas/src/Kconfig
```kconfig
#
# For a description of the syntax of this configuration file,
# see the file kconfig-language.txt in the NuttX tools repository.
#

if ARCH_RX65N
comment "RX65N Configuration Options"

menu "RX65N Peripheral Selections"

endmenu # RX65N Peripheral Selections
endif

if ARCH_RX65N_RSK1MB
comment "RX65N on RSKRX65N-1MB Configuration Options"

menu "RX65N Peripheral Selections"

endmenu # RX65N Peripheral Selections
endif

if ARCH_RX65N_RSK2MB
comment "RX65N on RSKRX65N-2MB Configuration Options"

menu "RX65N Peripheral Selections"

endmenu # RX65N Peripheral Selections
endif

if ARCH_RX65N_GRROSE
comment "RX65N on GR-ROSE Configuration Options"

menu "RX65N Peripheral Selections"

endmenu # RX65N Peripheral Selections
endif
```
