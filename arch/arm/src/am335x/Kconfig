## arch/renesas/src/rx65n/Kconfig
```kconfig
#
# For a description of the syntax of this configuration file,
# see the file kconfig-language.txt in the NuttX tools repository.
#

if ARCH_RX65N
comment "RX65N Configuration Options"

menu "RX65N Peripheral Selections"

config RX65N_SCI2
	bool "SCI2"
	default n
	select SCI2_SERIALDRIVER
config ICU
	bool "ICU"
	default y

endmenu # RX65N Peripheral Selections
endif

if ARCH_RX65N_RSK1MB
comment "RX65N on RSKRX65N-1MB Configuration Options"

menu "RX65N Peripheral Selections"

config RX65N_SCI2
	bool "SCI2"
	default n
	select SCI2_SERIALDRIVER
config ICU
	bool "ICU"
	default y

endmenu # RX65N Peripheral Selections
endif

if ARCH_RX65N_RSK2MB
comment "RX65N on RSKRX65N-2MB Configuration Options"

menu "RX65N Peripheral Selections"

config RX65N_SCI2
	bool "SCI2"
	select SCI2_SERIALDRIVER
config RX65N_SCI8
	bool "SCI8"
	select SCI8_SERIALDRIVER
config ICU
	bool "ICU"
	default y

endmenu # RX65N Peripheral Selections
endif

if ARCH_RX65N_GRROSE
comment "RX65N on GR-ROSE Configuration Options"

menu "RX65N Peripheral Selections"

config RX65N_SCI0
	bool "SCI0"
	default n
	select SCI0_SERIALDRIVER
config RX65N_SCI1
	bool "SCI1"
	default y
	select SCI1_SERIALDRIVER
config RX65N_SCI2
	bool "SCI2"
	default y
	select SCI2_SERIALDRIVER
config RX65N_SCI3
	bool "SCI3"
	default n
	select SCI3_SERIALDRIVER
config RX65N_SCI4
	bool "SCI4"
	default n
	select SCI4_SERIALDRIVER
config RX65N_SCI5
	bool "SCI5"
	default y
	select SCI5_SERIALDRIVER
config RX65N_SCI6
	bool "SCI6"
	default y
	select SCI6_SERIALDRIVER
config RX65N_SCI7
	bool "SCI7"
	default n
	select SCI7_SERIALDRIVER
config RX65N_SCI8
	bool "SCI8"
	default y
	select SCI8_SERIALDRIVER
config RX65N_SCI9
	bool "SCI9"
	default n
	select SCI9_SERIALDRIVER
config RX65N_SCI10
	bool "SCI10"
	default n
	select SCI10_SERIALDRIVER
config RX65N_SCI11
	bool "SCI11"
	default n
	select SCI11_SERIALDRIVER
config RX65N_SCI12
	bool "SCI12"
	default n
	select SCI12_SERIALDRIVER
config ICU
	bool "ICU"
	default y

endmenu # RX65N Peripheral Selections
endif
```

## configs/misoc/hello/defconfig
```kconfig
# CONFIG_LIBC_LONG_LONG is not set
# CONFIG_NSH_DISABLE_TELNETD is not set
# CONFIG_STANDARD_SERIAL is not set
CONFIG_ARCH="misoc"
CONFIG_ARCH_BOARD_CUSTOM_DIR="configs/misoc"
CONFIG_ARCH_BOARD_CUSTOM_NAME="misoc"
CONFIG_ARCH_CHIP_MINERVA=y
CONFIG_ARCH_MISOC=y
CONFIG_ARCH_STACKDUMP=y
CONFIG_ARCH_STDARG_H=y
CONFIG_BOARD_LOOPSPERMSEC=800
CONFIG_BOOT_RUNFROMEXTSRAM=y
CONFIG_BUILTIN=y
CONFIG_DEBUG_BINFMT=y
CONFIG_DEBUG_BINFMT_ERROR=y
CONFIG_DEBUG_BINFMT_WARN=y
CONFIG_DEBUG_ERROR=y
CONFIG_DEBUG_FEATURES=y
CONFIG_DEBUG_FS=y
CONFIG_DEBUG_FS_ERROR=y
CONFIG_DEBUG_FS_INFO=y
CONFIG_DEBUG_FS_WARN=y
CONFIG_DEBUG_INFO=y
CONFIG_DEBUG_LIB=y
CONFIG_DEBUG_LIB_ERROR=y
CONFIG_DEBUG_LIB_WARN=y
CONFIG_DEBUG_MM=y
CONFIG_DEBUG_MM_ERROR=y
CONFIG_DEBUG_MM_WARN=y
CONFIG_DEBUG_NET=y
CONFIG_DEBUG_NET_ERROR=y
CONFIG_DEBUG_NET_WARN=y
CONFIG_DEBUG_SCHED=y
CONFIG_DEBUG_SCHED_ERROR=y
CONFIG_DEBUG_SCHED_WARN=y
CONFIG_DEBUG_SYMBOLS=y
CONFIG_DEBUG_TIMER=y
CONFIG_DEBUG_TIMER_ERROR=y
CONFIG_DEBUG_TIMER_WARN=y
CONFIG_DEBUG_WARN=y
CONFIG_DISABLE_ENVIRON=y
CONFIG_DISABLE_MQUEUE=y
CONFIG_DISABLE_POSIX_TIMERS=y
CONFIG_DISABLE_PTHREAD=y
CONFIG_EXAMPLES_HELLO=y
CONFIG_EXAMPLES_NETTEST=y
CONFIG_EXAMPLES_NETTEST_DRIPADDR=0xc0a80101
CONFIG_EXAMPLES_NETTEST_INIT=y
CONFIG_EXAMPLES_NETTEST_IPADDR=0xc0a80132
CONFIG_EXAMPLES_NETTEST_NOMAC=y
CONFIG_EXPERIMENTAL=y
CONFIG_FS_PROCFS=y
CONFIG_IDLETHREAD_STACKSIZE=4096
CONFIG_MAX_TASKS=4
CONFIG_MAX_WDOGPARMS=2
CONFIG_MISOC_ETHERNET=y
CONFIG_MISOC_UART1=y
CONFIG_NET=y
CONFIG_NETDB_DNSCLIENT=y
CONFIG_NETDB_DNSSERVER_IPv4ADDR=0x08080808
CONFIG_NETUTILS_DISCOVER=y
CONFIG_NETUTILS_TELNETD=y
CONFIG_NETUTILS_WEBCLIENT=y
CONFIG_NET_ARP_IPIN=y
CONFIG_NET_ARP_SEND=y
CONFIG_NET_BROADCAST=y
CONFIG_NET_ETH_PKTSIZE=1400
CONFIG_NET_GUARDSIZE=648
CONFIG_NET_HOSTNAME="nuttx"
CONFIG_NET_ICMP=y
CONFIG_NET_ICMP_SOCKET=y
CONFIG_NET_MAX_LISTENPORTS=40
CONFIG_NET_SOCKOPTS=y
CONFIG_NET_TCP=y
CONFIG_NET_TCP_CONNS=40
CONFIG_NET_TCP_WRITE_BUFFERS=y
CONFIG_NET_UDP=y
CONFIG_NET_UDP_CHECKSUMS=y
CONFIG_NFILE_DESCRIPTORS=4
CONFIG_NFILE_STREAMS=4
CONFIG_NSH_BUILTIN_APPS=y
CONFIG_NSH_DISABLE_PS=y
CONFIG_NSH_DRIPADDR=0xc0a80101
CONFIG_NSH_IPADDR=0xc0a80132
CONFIG_NSH_NETINIT_DEBUG=y
CONFIG_NSH_NETLOCAL=y
CONFIG_NSH_NOMAC=y
CONFIG_NSH_READLINE=y
CONFIG_NUNGET_CHARS=0
CONFIG_PREALLOC_TIMERS=0
CONFIG_PREALLOC_WDOGS=4
CONFIG_PSEUDOFS_SOFTLINKS=y
CONFIG_PTHREAD_STACK_DEFAULT=4096
CONFIG_PTHREAD_STACK_MIN=2048
CONFIG_RAM_SIZE=33554432
CONFIG_RAM_START=0x40000000
CONFIG_RAW_BINARY=y
CONFIG_SCHED_HPWORK=y
CONFIG_SCHED_HPWORKSTACKSIZE=4096
CONFIG_SDCLONE_DISABLE=y
CONFIG_START_DAY=16
CONFIG_START_MONTH=6
CONFIG_START_YEAR=2011
CONFIG_STDIO_DISABLE_BUFFERING=y
CONFIG_SYSTEM_CLE=y
CONFIG_SYSTEM_DHCPC_RENEW=y
CONFIG_SYSTEM_NETDB=y
CONFIG_SYSTEM_NSH=y
CONFIG_SYSTEM_PING=y
CONFIG_SYSTEM_RAMTEST=y
CONFIG_TASK_NAME_SIZE=0
CONFIG_UART1_SERIAL_CONSOLE=y
CONFIG_USERMAIN_STACKSIZE=4096
CONFIG_USER_ENTRYPOINT="nsh_main"
CONFIG_WDOG_INTRESERVE=0
```

## fs/mtp/Kconfig
```kconfig
#
# For a description of the syntax of this configuration file,
# see the file kconfig-language.txt in the NuttX tools repository.
#

config FS_MTP
	bool "MTP Support"
	default n
	depends on !DISABLE_MOUNTPOINT
	select FS_READABLE
	select FS_WRITABLE
	---help---
		Enable MTP support

if FS_TMPFS

endif
```

## fs/spiffs/Kconfig
```kconfig
#
# For a description of the syntax of this configuration file,
# see the file kconfig-language.txt in the NuttX tools repository.
#

config FS_SPIFFS
	bool "SPIFFS File System"
	default n
	select FS_READABLE
	select FS_WRITABLE
	---help---
		Build the SPIFFS file system.  This is a port of version 0.3.7 of
		the SPIFFS file system by  Peter Andersson.  It was originally
		released under the MIT license.

if FS_SPIFFS

config SPIFFS_GCDBG
	bool "Enable garbage collection debug output"
	default n
	depends on DEBUG_FS_INFO

config SPIFFS_CACHEDBG
	bool "Enable cache debug output"
	default n
	depends on DEBUG_FS_INFO

config SPIFFS_CHECKDBG
	bool "Enable consistency check debug output"
	default n
	depends on DEBUG_FS_INFO

endif # FS_SPIFFS
```
